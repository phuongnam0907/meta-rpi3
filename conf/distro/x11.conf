## conf/distro/x11.conf
```bitbake
require conf/distro/poky.conf

DISTRO = "x11"
DISTRO_NAME = "X11"
DISTRO_VERSION = "1.0"
DISTRO_CODENAME = "warrior"

TARGET_VENDOR = "-x11"
DISTROOVERRIDES="x11"

LOCALCONF_VERSION = "1"

MAINTAINER = "Le Phuong Nam <le.phuong.nam@styl.solutions"

# Remove conflicting backends.

DISTRO_FEATURES_append = " x11 pam systemd alsa bluez5 opengl usbgadget usbhost wifi bluetooth"
DISTRO_FEATURES_remove = " wayland directfb vulkan"
VIRTUAL-RUNTIME_init_manager = "systemd"
DISTRO_FEATURES_BACKFILL_CONSIDERED = "sysvinit"
VIRTUAL-RUNTIME_initscripts = ""
```

## conf/machine/rasp3.conf
```bitbake
MACHINEOVERRIDES = "raspberrypi3:raspberrypi:${MACHINE}"

require conf/machine/include/tune-cortexa7.inc
include conf/machine/include/rpi-base.inc

DEFAULTTUNE ?= "cortexa7thf-neon-vfpv4"

RPI_KERNEL_DEVICETREE_OVERLAYS += "overlays/rpi-led-gpio.dtbo"
RPI_KERNEL_DEVICETREE_OVERLAYS += "overlays/gpio-led-seg.dtbo"
RPI_KERNEL_DEVICETREE_OVERLAYS += "overlays/i2c-pca.dtbo"
RPI_KERNEL_DEVICETREE_OVERLAYS += "overlays/rpi-pcd8544.dtbo"

RPI_KERNEL_DEVICETREE += "bcm2837-rpi-3-b.dtb"

SDIMG_KERNELIMAGE ?= "kernel7.img"
UBOOT_MACHINE = "rpi_3_32b_config"
SERIAL_CONSOLES ?= "115200;ttyS0"

ARMSTUB ?= "armstub7.bin"
```
